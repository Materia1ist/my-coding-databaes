/***************************************************************************
标题：	红外遥控控制继电器
效果：	使用配套的NEC遥控器，按下电源按键，继电器动作		
工作于：LY5A-L2A开发板
作者：	林洋电子吧
网站：	www.lydz8.com
******************************************************************************/
//头文件:
#include "reg51.h"

//IO引脚定义:
sbit JDQ=P1^4;		//继电器控制引脚
sbit hwx=P3^3;		//红外接收数据引脚，


/********数据定义*************************************************************/
unsigned char ly_lhj[4];					//保存NEC的四个字节数据
unsigned char ly_ct=0;						//计数时间量
bit ly_flag=0;								//成功接收标志

//函数声明:
void delay100us(void);

/***********主函数开始********************************************************/	
void main(void)
{
	EA=1;					//首先开启总中断
	EX1=1;  				//开启外部中断1,红外接收数据引脚
	IT1=1;        			//设置成下降沿触发方式
	while(1){	
		if(ly_flag){			//接收成功处理按键功能，这里只控制继电器，其它可自行加入
			ly_flag=0;
			if((ly_lhj[2]==0x00)&&(ly_lhj[3]=0xff))	//电源键的控制码
				JDQ=~JDQ;		//启动或关闭继电器，可控制其它设备
		}
	}		

}

/***********外中断1入口函数，P33引脚，红外线接收IC数据脚**************************/
void hongwai(void)   interrupt 2
{
	unsigned char i,ia;
	/**************开始判断是否为NEC波形引导码的前9MS和后4.5MS******************************/
	ly_ct=0;			//计数时间清0
	while(!hwx)
		delay100us();		//调用0.1MS延时计数，ly_ct每调用一次加1
	if(ly_ct<80||ly_ct>100)	//NEC引导码前9MS，ly_ct约等于90,给个误差值，用80-100之间来判断
		return;

	ly_ct=0;
	while(hwx){	
		delay100us();
		if(ly_ct>50)		//NEC引导码引导码的后4。5MS，ly_ct约45
			return;		
	}
	if(ly_ct<40)			//NEC引导码引导码的后4。5MS，ly_ct约45
		return;

	/***********开始接收四个字节内容**************************************/	
	for(i=0;i<4;i++){
		for(ia=0;ia<8;ia++){
			while(!hwx);		//低电平开始，不处理只等待高电平接收		
			
			ly_ct=0;
			while(hwx){			//高电平开始，
				delay100us();
				if(ly_ct>20)		
					return;		
			}
			//高电平结束，判断数据1或0向变量移入
			ly_lhj[i]>>=1;			//数据由高位移入低位
			if(ly_ct>10)				//时间量TH1高于10，即高于1MS判断为1
				ly_lhj[i]|=0x80;
		}
	}
	ly_flag=1;	//接收成功
	TF1=0;
}

void delay100us(void)
{
	unsigned char i=15;
	while(i--);
	ly_ct++;
}
