/**********************BST-V51实验开发板例程*******
*  平台：BST-V51 + Keil U3 + STC89C52
*  名称：声音感应车
*  公司：深圳市亚博智能科技有限公司       
*  日期：2015-6
*  晶振:11.0592MHZ
*  实验效果：有声音时，检测到，并让小车前进
*************************************************/
#include<reg52.h>

sbit IN1=P1^2; // 高电平1 后退（反转）
sbit IN2=P1^3; // 高电平1 前进（正转）

sbit IN3=P1^6; // 高电平1 前进（正转）	
sbit IN4=P1^7; // 高电平1 后退（反转）

sbit EN1=P1^4; // 高电平使能 
sbit EN2=P1^5; // 高电平使能 

sbit voice = P3^0;

void delay(unsigned int xms)				
{
	unsigned int i,j;
	for(i=xms;i>0;i--)		      //i=xms即延时约xms毫秒
		for(j=112;j>0;j--);
}
/*------------------------------------------------
               前进函数
------------------------------------------------*/
void run(unsigned int xms)
{
	EN1=1;
	EN2=1;//电机使能
    IN1=0;
	IN2=1; //左电机的正转
	IN3=1;
	IN4=0;//右电机的正转
	delay(xms);
}
/*------------------------------------------------
               停止函数
------------------------------------------------*/
void stop(void)			  //停止函数
{
	EN1=1;
	EN2=1;//电机使能
    IN1=0;
	IN2=0; //左电机不动
	IN3=0;
	IN4=0;//右电机正转
}

void main()
{
	while(1)
	{
		if(!voice)
		   run(500);
		else
			stop();
	}
}