
/**********************BST-V51实验开发板例程************************
*  平台：BST-V51 + Keil U3 + STC89C52
*  名称：串口通讯模块
*  公司：深圳市亚博智能科技有限公司      
*  日期：2013-11
*  晶振:11.0592MHZ
*  说明：免费开源，不提供源代码分析.
******************************************************************/
/*-----------------------------------------------
  名称：串口通信BST-V51直接用板上集成的USB串口通信功能就可以了，下载完成后，打开串口软件，关了下载
  STC软件,就可以正常做实验了，数码管会点亮，请自己加上关数码管源码。
  内容：连接好串口或者usb转串口至电脑，下载该程序，打开电源
        打开串口调试程序，将波特率设置为9600，无奇偶校验
        晶振11.0592MHz，发送和接收使用的格式相同，如都使用
        字符型格式，在发送框输入 hello，I Love MCU ，在接
        收框中同样可以看到相同字符，说明设置和通信正确
------------------------------------------------*/

#include<reg52.h> //包含头文件，一般情况不需要改动，头文件包含特殊功能寄存器的定义                        

                              
/******************************************************************/
/*                   主函数                                       */
/******************************************************************/
void main (void)
{


    SCON  = 0x50;		        /* SCON: 模式 1, 8-bit UART, 使能接收         */
    TMOD |= 0x20;               /* TMOD: timer 1, mode 2, 8-bit reload        */
    TH1   = 0xFD;               /* TH1:  reload value for 9600 baud @ 11.0592MHz   */
    TR1   = 1;                  /* TR1:  timer 1 run                          */
    EA    = 1;                  /*打开总中断*/
    ES    = 1;                  /*打开串口中断*/

while (1)                       /*主循环不做任何动作*/
    {
    }
}
/******************************************************************/
/*                  串口中断程序                                  */
/******************************************************************/
void UART_SER (void) interrupt 4 //串行中断服务程序
{
    unsigned char Temp;          //定义临时变量 
   
   if(RI)                        //判断是接收中断产生
     {
	  RI=0;                      //标志位清零
	  Temp=SBUF;                 //读入缓冲区的值
	  P1=Temp;                   //把值输出到P1口，用于观察
      SBUF=Temp;                 //把接收到的值再发回电脑端
	 }
   if(TI)                        //如果是发送标志位，清零
     TI=0;
} 
