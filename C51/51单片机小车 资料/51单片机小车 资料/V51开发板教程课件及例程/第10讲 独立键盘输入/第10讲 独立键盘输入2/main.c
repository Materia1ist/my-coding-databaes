/*********************************************************************************
*实验名   ：独立键盘输入
*实验效果	：按第1个独立按键K1 松开按键后 第一个LED灯状态改变
*
*********************************************************************************/
#include<reg52.h>
#include"bstv51.h"

void delay(uint xms)
{
    uint i,j;
	for(i=xms;i>0;i--)
	  for(j=112;j>10;j--);
}

void main()
{
	bstv51_init();//学习板初始化函数
	P1=0xff; //熄灭所有LED
    while(1)
	{
	    if(K1==0)			//判断是否有按下信号
		{
		    delay(10);		  //延时10ms
			if(K1==0)			//再次判断是否按下
			{
			    while(K1==0);	//判断是否松开按键
			    L0=~L0;			//松开后执行程序 翻转LED灯
			}
		    
		}

	
	}

}